## conf/layer.conf
```bitbake
# We have a conf and classes directory, add to BBPATH
BBPATH .= ":${LAYERDIR}"

# We have recipes-* directories, add to BBFILES
BBFILES += "${LAYERDIR}/recipes-*/*/*.bb \
	${LAYERDIR}/recipes-*/*/*.bbappend"

BBFILE_COLLECTIONS += "updatehub"
BBFILE_PATTERN_updatehub = "^${LAYERDIR}/"
BBFILE_PRIORITY:updatehub = "8"

SIGGEN_EXCLUDERECIPES_ABISAFE += " \
    updatehub-machine-info \
"

LAYERSERIES_COMPAT_updatehub = "walnascar"

LAYERDEPENDS:updatehub = " \
    core \
    meta-python \
    networking-layer \
    openembedded-layer \
"

BBFILES_DYNAMIC += " \
    qt5-layer:${LAYERDIR}/dynamic-layers/qt5/*/*/*.bb \
    qt5-layer:${LAYERDIR}/dynamic-layers/qt5/*/*/*.bbappend \
"

# generic updatehub product uid
UPDATEHUB_PRODUCT_UID ??= "0000000000000000000000000000000000000000000000000000000000000000"

UPDATEHUB_PACKAGE_VERSION_SUFFIX ??= ""
UPDATEHUB_PACKAGE_VERSION:append = "${UPDATEHUB_PACKAGE_VERSION_SUFFIX}"

PREFERRED_RPROVIDER_virtual-grub-bootconf ??= "updatehub-grub-script"
```

## recipes-core/images/updatehub-image-minimal.wks
```
part /boot --source bootimg-partition --ondisk mmcblk --fstype=vfat --label boot --active --align 4 --size 4
part / --source rootfs --ondisk mmcblk --fstype=ext4 --label system --size 40M --align 8192 --extra-space 0
part / --source rootfs --ondisk mmcblk --fstype=ext4 --label system --size 40M --align 8192 --extra-space 0

bootloader --ptable gpt
```
